// generated by Block & modified for Serial Parsing
#include <ACB_Spider_ESP8266.h>
#include <Arduino.h>

String msg; // Changed to String for parsing
ACB_Spider_ESP8266 spider;

void setup() {
  Serial.begin(115200);
  spider.servo_init();
  spider.init(0);
}

void loop() {
  if (Serial.available() > 0) {
    // Read the incoming command until newline
    msg = Serial.readStringUntil('\n');
    msg.trim(); // Remove any stray whitespace/carriage returns

    // Check if it's a valid Spider command (starts with S:)
    if (msg.startsWith("S:")) {

      // --- MOTION CONTROLS ---
      if (msg.indexOf(":STP:") > 0) {
        spider.stop();
      } else if (msg.indexOf(":MFW:") > 0) {
        spider.forward();
      } else if (msg.indexOf(":MBW:") > 0) {
        spider.backward();
      } else if (msg.indexOf(":MSL:") > 0) {
        spider.leftMove();
      } else if (msg.indexOf(":MSR:") > 0) {
        spider.rightMove();
      } else if (msg.indexOf(":RTL:") > 0) {
        spider.leftTurn();
      } else if (msg.indexOf(":RTR:") > 0) {
        spider.rightTurn();
      }

      // --- ACTION CONTROLS (S:ACT:X) ---
      else if (msg.startsWith("S:ACT:")) {
        // Extract the number at the end of the string
        int actionID = msg.substring(6).toInt();

        switch (actionID) {
        case 1:
          spider.standby();
          break;
        case 2:
          spider.lying();
          break;
        case 3:
          spider.sleep();
          break;
        case 4:
          spider.greet();
          break;
        case 5:
          spider.pushup();
          break;
        case 6:
          spider.fighting();
          break;
        case 7:
          spider.dancing();
          break;
        case 8:
          spider.swing();
          break;
        case 9:
          spider.handsome();
          break;
        }
      }
    }
  }
  repeat();
}

void repeat() { spider.loop(); }